/* source key position labels */
#include "zmk-helpers/key-labels/totem.h"

/* map Corne's extra keys */
#define X_LB  &trans
#define X_LH  &lt SYM ESC  // thumb row, left

#define X_RB  &to GAME     // bottom row, right
#define X_RH  &bs_del      // thumb row, right

/* activate bluetooth */
// #define CONFIG_WIRELESS 1

/* source the main keymap */
#include "base.keymap"
